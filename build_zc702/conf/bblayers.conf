## build_zc702/conf/bblayers.conf
```bitbake
# LAYER_CONF_VERSION is increased each time build/conf/bblayers.conf
# changes incompatibly
LCONF_VERSION = "5"

BBPATH = "${TOPDIR}"
BBFILES ?= ""

BBLAYERS ?= " \
  ${TOPDIR}/../meta \
  ${TOPDIR}/../meta-oe/meta-oe \
  ${TOPDIR}/../meta-xilinx \
  ${TOPDIR}/../meta-xilinx/meta-zc702 \
  ${TOPDIR}/../meta-xilinx/meta-zc702 \
  ${TOPDIR}/../meta-userperipheral-public \
  "

BBLAYERS_NON_REMOVABLE ?= " \
  ${TOPDIR}/../meta \
  "
```

## build_zc706/conf/bblayers.conf
```bitbake
# LAYER_CONF_VERSION is increased each time build/conf/bblayers.conf
# changes incompatibly
LCONF_VERSION = "5"

BBPATH = "${TOPDIR}"
BBFILES ?= ""

BBLAYERS ?= " \
  ${TOPDIR}/../meta \
  ${TOPDIR}/../meta-oe/meta-oe \
  ${TOPDIR}/../meta-xilinx \
  ${TOPDIR}/../meta-zynq-gnuradio \
  "

BBLAYERS_NON_REMOVABLE ?= " \
  ${TOPDIR}/../meta \
  "
```

## meta-xilinx/meta-zc706/conf/layer.conf
```bitbake
# We have a conf and classes directory, add to BBPATH
BBPATH := "${BBPATH}:${LAYERDIR}"

# We have a packages directory, add to BBFILES
BBFILES := "${BBFILES} ${LAYERDIR}/recipes-*/*/*.bb"
BBFILES += " ${LAYERDIR}/recipes-*/*/*.bbappend"

BBFILE_COLLECTIONS += "zc706"
BBFILE_PATTERN_zc706 := "^${LAYERDIR}/"
BBFILE_PRIORITY_zc706 = "8"
```

## meta-xilinx/meta-zc706/conf/machine/zc706.conf
```bitbake
#@TYPE: Machine
#@NAME: ZC706
#@DESCRIPTION: Machine support for ZC706.

# Versions corresponding to zedboard documentation
PREFERRED_VERSION_linux-xlnx ?= "3.8%"
PREFERRED_VERSION_u-boot-xlnx ?= "v2013.01%"

require conf/machine/include/tune-zynq.inc

# ZC706 machine definition known by Xilinx UBOOT
UBOOT_MACHINE = "zynq_zc70x_config"

SERIAL_CONSOLE = "115200 ttyPS0"
```
